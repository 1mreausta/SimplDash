## main/Kconfig.projbuild
```kconfig
menu "SimplDash"

    config SIMPLDASH_CAN_TX_GPIO
        int "CAN TX GPIO (-> SN65HVD230 D / CTX)"
        default 45
        help
            ESP32-P4 GPIO, mis läheb transiiveri TX (D) sisendisse.
            Vali vaba pinn plaadi päisest – kontrolli skeemist.

    config SIMPLDASH_CAN_RX_GPIO
        int "CAN RX GPIO (<- SN65HVD230 R / CRX)"
        default 46

    config SIMPLDASH_CAN_BITRATE
        int "CAN bitikiirus"
        default 500000
        help
            Peab klappima MTune CAN1 seadega (vaikimisi 500 kbit/s).

    config SIMPLDASH_CAN_LISTEN_ONLY
        bool "Listen-only režiim (ei kinnita kaadreid)"
        default n
        help
            Lülita sisse ainult siis, kui CAN-siinil on peale ECU ja dashi veel
            mõni seade, mis kaadreid kinnitab (ACK). Kui ECU ja dash on kahekesi,
            JÄTA VÄLJA – muidu ECU kaadreid ei kinnitata.

    config SIMPLDASH_DEMO_ON_BOOT
        bool "Käivitu demorežiimis"
        default n
        help
            Demorežiimi saab ka ekraani 3 s hoidmisega sisse/välja lülitada.

    config SIMPLDASH_PAGE_BUTTON_GPIO
        int "Vaate nupu GPIO (-1 = pole)"
        default 47
        range -1 54
        help
            Valikuline füüsiline nupp (nt roolil) vaadete vahetamiseks.
            Nupp ühendab GPIO maaga (GND); sisemine pull-up on sees.
            Lühike vajutus = järgmine vaade.

    config SIMPLDASH_GPS_RX_GPIO
        int "GPS RX GPIO (<- GPS mooduli TX), -1 = GPS puudub"
        default -1
        range -1 54
        help
            Nt Ebyte E108-GN04G-TTL: mooduli TX juhe sellesse GPIO-sse (3,3 V loogika).
            Vali vaba pinn plaadi päisest.

    config SIMPLDASH_GPS_TX_GPIO
        int "GPS TX GPIO (-> GPS mooduli RX), -1 = ei kasuta"
        default -1
        range -1 54
        help
            Soovitatav: ilma selleta ei saa dash moodulit 10 Hz peale seadistada
            (siis jääb mooduli vaikesagedus, tavaliselt 1 Hz). Vt DASH_GPS_RATE_HZ.

    config SIMPLDASH_GPS_BAUD
        int "GPS UART kiirus"
        default 38400
        help
            E108-GN04G vaikimisi 38400.

endmenu
```
